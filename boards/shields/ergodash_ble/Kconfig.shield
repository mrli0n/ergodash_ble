## boards/shields/ergodash_ble/Kconfig.shield
```kconfig
# Copyright (c) 2020 The ZMK Contributors
# SPDX-License-Identifier: MIT

config SHIELD_ERGODASH_BLE_LEFT
    def_bool $(shields_list_contains,ergodash_ble_left)

config SHIELD_ERGODASH_BLE_RIGHT
    def_bool $(shields_list_contains,ergodash_ble_right)
```
